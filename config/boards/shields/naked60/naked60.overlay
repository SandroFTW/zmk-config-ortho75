/*
 * Copyright (c) 2020 The ZMK Contributors
 *
 * SPDX-License-Identifier: MIT
 */

/ {
    chosen {
        zmk,kscan = &kscan0;
    };

    kscan0: kscan_0 {
        compatible = "zmk,kscan-gpio-matrix";
        wakeup-source;
        diode-direction = "row2col";

        col-gpios
            = <&gpio0 6 (GPIO_ACTIVE_HIGH | GPIO_PULL_DOWN)> // col 0
            , <&gpio0 8 (GPIO_ACTIVE_HIGH | GPIO_PULL_DOWN)> // col 1
            , <&gpio0 17 (GPIO_ACTIVE_HIGH | GPIO_PULL_DOWN)> // col 2
            , <&gpio0 20 (GPIO_ACTIVE_HIGH | GPIO_PULL_DOWN)> // col 3
            , <&gpio0 22 (GPIO_ACTIVE_HIGH | GPIO_PULL_DOWN)> // col 4
            , <&gpio0 24 (GPIO_ACTIVE_HIGH | GPIO_PULL_DOWN)> // col 5
            , <&gpio1 0 (GPIO_ACTIVE_HIGH | GPIO_PULL_DOWN)> // col 6
            , <&gpio1 6 (GPIO_ACTIVE_HIGH | GPIO_PULL_DOWN)> // col 7
            , <&gpio1 4 (GPIO_ACTIVE_HIGH | GPIO_PULL_DOWN)> // col 8
            , <&gpio0 11 (GPIO_ACTIVE_HIGH | GPIO_PULL_DOWN)> // col 9
            , <&gpio1 1 (GPIO_ACTIVE_HIGH | GPIO_PULL_DOWN)> // col 10
            , <&gpio1 2 (GPIO_ACTIVE_HIGH | GPIO_PULL_DOWN)> // col 11
            , <&gpio1 11 (GPIO_ACTIVE_HIGH | GPIO_PULL_DOWN)> // col 12
            , <&gpio0 10 (GPIO_ACTIVE_HIGH | GPIO_PULL_DOWN)> // col 13
            , <&gpio0 9 (GPIO_ACTIVE_HIGH | GPIO_PULL_DOWN)> // col 14
            ;

        row-gpios
            = <&gpio1 13 GPIO_ACTIVE_HIGH> // row 0
            , <&gpio1 15 GPIO_ACTIVE_HIGH> // row 1
            , <&gpio0 2 GPIO_ACTIVE_HIGH> // row 2
            , <&gpio0 29 GPIO_ACTIVE_HIGH> // row 3
            , <&gpio0 31 GPIO_ACTIVE_HIGH> // row 4
            ;
    };
};